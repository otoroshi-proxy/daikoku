## daikoku/conf/local.conf
```bitbake
include "base.conf"

daikoku {
  mode = "dev"
  signingKey = "secret"
  storage = "postgres"
  exposedOn= 5173
  init {
    data {
      from = "javascript/tests/config/daikoku/daikoku_state_very_local.ndjson"
    }
  }

  health {
    accessKey = "secret"
  }

  otoroshi {
    sync {
      cron = true
    }
  }

  postgres {
    database = "postgres"
  }


  tenants {
    provider = "hostname"
  }
}
```
